## components/lua/Kconfig
```kconfig
menu "Lua runtime"

    choice CLU_LUA_VERSION
        prompt "Lua version"
        default CLU_LUA_5_3
        help
            Real CLU firmware embeds Lua 5.3, and OM.LUA / user scripts are written for it.
            Lua 5.5 is faster and leaner, but rejects scripts that use `global` as a name or
            assign to a for-loop variable, and has no bit32 library.

        config CLU_LUA_5_3
            bool "Lua 5.3.6 (same as real CLU)"
        config CLU_LUA_5_5
            bool "Lua 5.5.1 (experimental)"
    endchoice

    config CLU_LUA_32BITS
        bool "Use 32-bit Lua integers and floats"
        default n
        help
            Build Lua with 32-bit integers and single-precision floats instead of 64-bit integers
            and doubles. Serial numbers at or above 2^31 become negative, millis exceeds the
            signed integer range after about 24.9 days, and floats retain only about 7 significant
            digits.

    config CLU_LUA_FLOAT
        bool "Use single-precision Lua numbers"
        depends on !CLU_LUA_32BITS
        default y
        help
            Use 32-bit floats for Lua numbers while keeping 64-bit Lua integers. Floating-point
            values retain about 7 significant digits; serial numbers and other integers remain
            64-bit. This setting is unavailable when CLU_LUA_32BITS is enabled.

    config CLU_LUA_PRECOMPILE
        bool "Precompile embedded Lua libraries to bytecode"
        default n
        help
            Compile the Lua libraries built into the firmware (prelude, objects, mqtt, http,
            mysensors) to stripped bytecode on the build host: about 40% (~50 KB) less flash and
            no parsing at boot. Stripped chunks carry no line numbers or local names, so errors
            raised inside these libraries have no file:line. Turn off when debugging them.
            Needs a host C compiler (cc / gcc / clang). User scripts (a:\*.LUA) are unaffected.

    config CLU_LUA_MEM_LIMIT_KB
        int "Lua heap limit (KB)"
        default 4096
        range 256 7680
        help
            Total memory one Lua state may hold (PSRAM + internal RAM). Allocations above it
            fail with a Lua "not enough memory" error after an emergency GC, instead of starving
            WiFi / lwIP of RAM.

    config CLU_LUA_INTERNAL_RESERVE_KB
        int "Internal RAM kept free for the system (KB)"
        default 64
        range 16 256
        help
            When PSRAM is full, Lua falls back to internal RAM only while at least this much
            internal RAM stays free.

endmenu
```
