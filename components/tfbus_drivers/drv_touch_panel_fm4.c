/**
 * @file drv_touch_panel_fm4.c
 * @brief TOUCH_PANEL_FM_4 driver (hwType 28 / 0x1c).
 *
 * Objects: 4x BUTTON (class 7), PANELSENSTEMP (20), PANELSENSLIGHT (21), PANEL (29, buzzer),
 * PowerSupplyVoltage (12). Interface: module_2_0_TOUCH_PANEL_FM_4_fv01_02.xml.
 *
 * Init, verified against a real CLU capture:
 * @verbatim
 *   per button b: SET_OUTPUT(0x01)[1<<b,0,0], MODULE_PARAM(0x0f)[b,0,0,0]
 *   SENSOR_SENSITIVITY(0x00): [07,01,02,00] [07,0a,02,00] [08,01,0a,00] [08,0a,0a,00]
 *     (replicated verbatim; meaning not decoded - byte 1 is not the threshold, see SMART_PANEL)
 *   0x03 meta 01 [buzzer]   (= PANEL:set(13, BuzzerValue) from OnInit)
 * @endverbatim
 * Status:
 * @verbatim
 *   02 | 06 01 01 [state] | one of: 02 02 10 [temp LE 0.01C] / 07 02 10 [light LE 0.01%] /
 *        08 02 10 [btn*7+event, 0]
 * @endverbatim
 * Button events are generated by the panel (incl. hold/long).
 *
 * UNVERIFIED: LED on/off = SET_OUTPUT[1<<b, 1|0, 0].
 */
#include <math.h>
#include <stdio.h>
#include <stdlib.h>
#include <string.h>

#include "clu_lua.h"
#include "drv_panel_common.h"
#include "esp_log.h"
#include "lauxlib.h"
#include "tfbus_drivers.h"
#include "tfbus_master.h"

static const char *TAG = "drv_tp4";

#define BTN 4
/** @brief OM object classes hosted on the panel. */
enum { CLS_BUTTON = 7, CLS_TEMP = 20, CLS_LIGHT = 21, CLS_PANEL = 29 };
/** @brief Driver state per module (drv_ctx). */
typedef struct {
    char btn[BTN][24];
    uint32_t btn_value;
    panel_sensor_t temp, light;
    bool buzzer;
} tp4_t;

/** @brief Driver state of @p m, allocated (with sensor defaults) on first use. */
static tp4_t *ctx(tfbus_module_t *module)
{
    if (!module->drv_ctx) {
        tp4_t *panel_state = calloc(1, sizeof *panel_state);
        if (!panel_state) {
            abort(); // out of memory while loading OM.LUA: reboot instead of a NULL dereference
        }
        panel_state->temp = (panel_sensor_t){.threshold = 0.1, .min = 0, .max = 40};
        panel_state->light = (panel_sensor_t){.threshold = 0.1, .min = 0, .max = 100};
        panel_state->buzzer = true;
        module->drv_ctx = panel_state;
    }
    return module->drv_ctx;
}

/**
 * @brief tfbus_driver_t::init: queue the captured init sequence (buttons, sensor sensitivity, buzzer).
 */
static void init(tfbus_module_t *module)
{
    tp4_t *panel_state = ctx(module);
    for (int b = 0; b < BTN; b++) {
        drv_queue_record(module, 0x01, 0x00, (uint8_t[]){(uint8_t)(1 << b), 0, 0}, 3);
        drv_queue_record(module, 0x0f, 0x00, (uint8_t[]){(uint8_t)b, 0, 0, 0}, 4);
    }
    drv_queue_record(module, 0x00, 0x00, (uint8_t[]){0x07, 0x01, 0x02, 0}, 4);
    drv_queue_record(module, 0x00, 0x00, (uint8_t[]){0x07, 0x0a, 0x02, 0}, 4);
    drv_queue_record(module, 0x00, 0x00, (uint8_t[]){0x08, 0x01, 0x0a, 0}, 4);
    drv_queue_record(module, 0x00, 0x00, (uint8_t[]){0x08, 0x0a, 0x0a, 0}, 4);
    drv_queue_record(module, 0x03, 0x01, (uint8_t[]){panel_state->buzzer}, 1);
}

/** @brief tfbus_driver_t::io_new: remember the Lua name of a button / sensor. */
static void io_new(tfbus_module_t *module, int cls, int channel_index, const char *name)
{
    tp4_t *panel_state = ctx(module);
    if (cls == CLS_BUTTON && channel_index >= 0 && channel_index < BTN) {
        strlcpy(panel_state->btn[channel_index], name, sizeof panel_state->btn[channel_index]);
    } else if (cls == CLS_TEMP) {
        strlcpy(panel_state->temp.name, name, sizeof panel_state->temp.name);
    } else if (cls == CLS_LIGHT) {
        strlcpy(panel_state->light.name, name, sizeof panel_state->light.name);
    }
}

/**
 * @brief tfbus_driver_t::io_set: cache sensor Threshold (1) / Min (3) / Max (4); PANEL BuzzerValue (13) is sent.
 */
static bool io_set(tfbus_module_t *module, lua_State *L, int obj, int cls, int channel_index, int idx, int val)
{
    tp4_t *panel_state = ctx(module);
    panel_sensor_t *sensor_config = cls == CLS_TEMP ? &panel_state->temp : cls == CLS_LIGHT ? &panel_state->light : NULL;
    if (sensor_config) {
        double sensor_value = luaL_optnumber(L, val, 0);
        if (idx == 1) {
            sensor_config->threshold = sensor_value;
        } else if (idx == 3) {
            sensor_config->min = sensor_value;
        } else if (idx == 4) {
            sensor_config->max = sensor_value;
        }
    } else if (cls == CLS_PANEL && idx == 13) {
        panel_state->buzzer = luaL_optinteger(L, val, 1) != 0;
        drv_queue_record(module, 0x03, 0x01, (uint8_t[]){panel_state->buzzer}, 1);
    }
    return false;
}

/** @brief tfbus_driver_t::io_execute: BUTTON LedSwitchOn (1) / LedSwitchOff (2). */
static int io_execute(tfbus_module_t *module, lua_State *L, int obj, int cls, int channel_index, int idx, int first,
                      int nargs)
{
    if (cls != CLS_BUTTON || channel_index < 0 || channel_index >= BTN) {
        return -1;
    }
    switch (idx) {
    case 1: // LedSwitchOn
    case 2: // LedSwitchOff
        drv_queue_record(module, 0x01, 0x00, (uint8_t[]){(uint8_t)(1 << channel_index), idx == 1, 0}, 3);
        return 0;
    default:
        ESP_LOGW(TAG, "%s: execute(%d) not implemented", ctx(module)->btn[channel_index], idx);
        return 0;
    }
}

/** @brief tfbus_driver_t::on_status: temperature, light and button event records. */
static void on_status(tfbus_module_t *module, const uint8_t *status_payload, size_t len)
{
    tp4_t *panel_state = ctx(module);
    tfbus_tlv_t status_records[4];
    int status_record_count = tfbus_parse_tlv(status_payload, len, status_records, 4);
    for (int i = 0; i < status_record_count; i++) {
        if (status_records[i].len < 2) {
            continue;
        }
        uint16_t record_value = (uint16_t)(status_records[i].data[0] | status_records[i].data[1] << 8);
        switch (status_records[i].type) {
        case 0x02: panel_sensor_update(&panel_state->temp, record_value / 100.0); break;
        case 0x07: panel_sensor_update(&panel_state->light, record_value / 100.0); break;
        case 0x08: panel_button_event(panel_state->btn, BTN, &panel_state->btn_value, NULL, status_records[i].data[0]); break;
        default: break;
        }
    }
}

const tfbus_driver_t tfbus_drv_touch_panel_fm4 = {
    .hw_type = 0x1c,
    .name = "TOUCH_PANEL_FM_4",
    .init = init,
    .on_status = on_status,
    .io_new = io_new,
    .io_set = io_set,
    .io_execute = io_execute,
};
